## board/freescale/mx6ull_lsx_emmc/Kconfig
```kconfig
if TARGET_MX6ULL_LSX_EMMC

config SYS_BOARD
	default "mx6ull_lsx_emmc"

config SYS_VENDOR
	default "freescale"

config SYS_CONFIG_NAME
	default "mx6ull_lsx_emmc"

endif
```
